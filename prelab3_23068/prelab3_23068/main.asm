.include "M328PDEF.inc"
.cseg
.org 0x0000
	JMP START
.org 0x0008
	JMP PINCHANGEC_ISR

START:
// Configuraci n de la pila?
	LDI R16, LOW(RAMEND)
	OUT SPL, R16
	LDI R16, HIGH(RAMEND)
	OUT SPH, R16	

SETUP:
	CLI
	LDI R16, (1 << CLKPCE)
	STS CLKPR, R16
	LDI R16, 0b00000100
	STS CLKPR,R16


	LDI R16, (1 << PCIE1)
	STS PCICR, R16
	LDI R16, (1 << PCINT9)|(1 << PCINT8)
	STS PCMSK1, R16

	
	LDI R16,0x00
	OUT PORTD, R16
	OUT PORTB, R16
	STS UCSR0B, R16
	OUT DDRC,R16
	LDI R16,0xFF
	OUT PORTC, R16
	OUT DDRB,R16
	OUT DDRD, R16
	OUT PORTD,R16
	
	SEI

//Contador
	LDI R16,0x00
	LDI R17,0x00

; Replace with your application code
MAIN_LOOP:
	CALL DELAY
	IN R17, PINC
	ANDI R17, 0xF0
	ADD R17, R16
	OUT PORTB, R17
	RJMP MAIN_LOOP

DELAY:
LDI R31,0x00
subdelay1:
INC R31
CPI R31,0x00
BRNE subdelay1
RET

PINCHANGEC_ISR:
	SBIS PINC,0
	INC R16
	SBIS PINC,1
	DEC R16
	ANDI R16,0x0F
RETI
