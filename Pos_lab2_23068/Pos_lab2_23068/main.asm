;
; Pos_lab2_23068.asm
;
; Created: 2/13/2025 3:44:54 PM
; Author : oscar
;

.include "M328PDEF.inc"
.cseg
.org 0x0000

START:
// Configuraci n de la pila?
	LDI R16, LOW(RAMEND)
	OUT SPL, R16
	LDI R16, HIGH(RAMEND)
	OUT SPH, R16

DIS: .DB 0x3F,0x05,0x5B,0x4F,0x65,0x6E,0x7E,0x07,0x7F,0x67,0x77,0x7F,0x3A,0x3F,0x7A,0x72

SETUP:
	LDI R29,0x00

	LDI R16, 0x00
	STS UCSR0B, R16
	LDI R16, 0xF0
	OUT DDRC, R16
	LDI R16, 0x0F
	OUT PORTC, R16
	LDI R16, 0xFF
	OUT DDRD, R16
	OUT DDRB, R16
	OUT PORTD,R16
	OUT PORTB,R16


	CALL TIMER
	LDI R20, 0x00
	LDI R30, 0x00


LOOP:
	IN R16,PINC
	SBRS R16,PC0
	JMP SUMAR
	
	IN R16, PINC
	SBRS R16,PC1
	JMP RESTAR
	
	IN R26,TIFR0
	CPI R26, (1 >> TOV0)
	BRNE LOOP

	CPI R20,15
	BREQ ZERO
	
	LDI R26, 100
	OUT TCNT0, R26
	
	SBI TIFR0, TOV0

	INC R30
	CPI R30,100
	BRNE LOOP
	CLR R30

	INC R20
	OUT PORTB,R20

	LDI ZH, HIGH(DIS << 1)
	LDI ZL, LOW(DIS << 1)
	ADD ZL,R29
	LPM R21, Z
	OUT PORTD, R21

	CP R29,R20
	BRNE LOOP
	SBIC PORTC,3
	SBI PINC, PC4
	LDI R20,0xFF

	RJMP LOOP

DELAY:
	IN R26, TIFR0
	CPI R26, (1 << TOV0)
	BRNE DELAY
	LDI R26,100
	OUT TCNT0, R26
	SBI TIFR0, TOV0
	INC R30

	SBIS PINC, (PC1 & PC0)
	RJMP DELAY
	RJMP LOOP

SUMAR:
	CPI R29,0x0F
	BREQ OVERF
	INC R29
	RJMP DELAY
SUMAR2:
	INC R29 
	RJMP DELAY
OVERF:
	LDI R29,0xFF
	JMP SUMAR2

RESTAR:
	CPI R29,0x00
	BREQ UNDERF
	DEC R29
	RJMP DELAY
RESTAR2:
	DEC R29 
	RJMP DELAY
UNDERF:
	LDI R29,0xFF
	JMP RESTAR2

ZERO:
	LDI R20, 0xFF



TIMER:
	LDI R27, (1 << CS02)|(1 << CS00)
	OUT TCCR0B, R27

	LDI R27, 100
	OUT TCNT0, R27
	RET
