;
; Pruebas_Proyecto_1_Micros.asm
;
; Created: 2/20/2025 2:52:01 PM
; Author : oscar
;
.include "M328PDEF.inc"
.cseg
.org 0x0000
	JMP START
.org 0x0008
	JMP PINCHANGEC_ISR
.org 0x0020
	JMP TMR0_ISR


START:
// Configuraci n de la pila?
	LDI R16, LOW(RAMEND)
	OUT SPL, R16
	LDI R16, HIGH(RAMEND)
	OUT SPH, R16	

DIS: .DB 0x3F,0x05,0x5B,0x4F,0x65,0x6E,0x7E,0x07,0x7F,0x67,0x77,0x7F,0x3A,0x3F,0x7A,0x72
MESES: .DB 0x32,0x29,0x32,0x31,0x32,0x31,0x32,0x32,0x31,0x32,0x31,0x32

SETUP:
	CLI



	LDI R16,(1 << CS01)|(1 << CS00)
	OUT TCCR0B, R16
	LDI R16,100
	OUT TCNT0, R16

	LDI R16, (1 << TOIE0)
	STS TIMSK0, R16

	LDI R16, (1 << PCIE1)
	STS PCICR, R16
	LDI R16,(1 << PCINT13)|(1 << PCINT11)|(1 << PCINT10)|(1 << PCINT9)|(1 << PCINT8)
	STS PCMSK1, R16

	
	LDI R16,0x00
	OUT PORTD, R16
	OUT PORTB, R16
	STS UCSR0B, R16
	LDI R16,0x30
	OUT DDRC,R16
	LDI R16,0xFF
	OUT PORTC, R16
	OUT DDRB,R16
	OUT DDRD, R16
	
	SEI

// Contador horas y mins
	LDI R16,0x00
	LDI R17,0x00
	LDI R18,0x00
	LDI R19,0x00
// Contadores para minutos
	LDI R20,0x00
	LDI R21,0x00
// Valor a mostrar en displays
	LDI R22,0x00
// Valores temporales
	LDI R23,0x00
// Modo del sistema
	LDI R24,0x01
// Registros Alarma y Fecha
	LDI R25,0x00
	LDI R26,0x00
	LDI R27,0x00
	LDI R28,0x00
// Registro para puntos cada 500ms
	LDI R29,0x00
//ANTIREBOTE
// Registro para el delay de los displays
	LDI R31,0x00

	
	CBI PORTC,5
	LDI ZH, 0x01
	LDI ZL, 0x00
	ST Z,R25
	LDI ZH, 0x01
	LDI ZL, 0x01
	ST Z,R26
	LDI ZH, 0x01
	LDI ZL, 0x02
	ST Z,R27
	LDI ZH, 0x01
	LDI ZL, 0x03
	ST Z,R28
	LDI ZH, 0x02
	LDI ZL, 0x00
	ST Z,R25
	LDI ZH, 0x02
	LDI ZL, 0x01
	ST Z,R26
	LDI ZH, 0x02
	LDI ZL, 0x02
	ST Z,R27
	LDI ZH, 0x02
	LDI ZL, 0x03
	ST Z,R28

; Replace with your application code
MAIN_LOOP:
	CPI R21, 24
	BRNE FINAL
	CLR R20
	CLR R21
	INC R16
	CPI R16,0x0A
	BRBS 1, CERO
DECENAS:
	CPI R17,0x06
	BRBS 1, CERO2
CENTENAS:
	CPI R18,0x04
	BRBS 1, CERO3
CENTENAS2:
	CPI R18,0x0A
	BRBS 1, CERO4
FINAL:
	CPI R24,0x03
	BREQ APAGADO
	CPI R24,0x01
	BREQ RELOJ_ALARMA
	CPI R24,0x02
	BREQ ALARMA
	CPI R24,0x00
	BREQ FECHA
	JMP MAIN_LOOP

APAGADO:
JMP M_APAGAR
RELOJ_ALARMA:
JMP M_RELOJ_ALARMA
FECHA:
JMP M_FECHA
ALARMA:
JMP M_ALARMA

CERO:
	LDI R16, 0x00
	INC R17
	RJMP DECENAS
CERO2:
	LDI R17, 0x00
	INC R18
	RJMP CENTENAS
CERO3:
	CPI R19,0x02
	BRNE CENTENAS2
	LDI R18,0x00
	LDI R19,0x00
	RJMP FINAL
CERO4:
	LDI R18,0x00
	INC R19
	RJMP FINAL

M_APAGAR:
	CBI PORTC, 4
	CBI PORTB, 4
	CBI PORTB, 5
	CBI PORTB, 0
	CBI PORTB, 1
	CBI PORTB, 2
	CBI PORTB, 3
	LDI ZH, 0x02
	LDI ZL, 0x00
	LD R25,Z
	LDI ZH, 0x02
	LDI ZL, 0x01
	LD R26,Z
	LDI ZH, 0x02
	LDI ZL, 0x02
	LD R27,Z
	LDI ZH, 0x02
	LDI ZL, 0x03
	LD R28,Z
	JMP MAIN_LOOP

ALARMA_CERO1:
	LDI R25,0x00
	INC R26
	JMP ALARMA_MINS_UNIDADES2
ALARMA_CERO2:
	LDI R25,0x09
	DEC R26 
	JMP ALARMA_MINS_DECENAS
ALARMA_CERO3:
	LDI R26,0x00
	JMP ALARMA_MINS_DECENAS2
ALARMA_CERO4:
	LDI R26,0x5
	JMP ALARMA_HORAS_UNIDADES
ALARMA_CERO5:
	LDI R27,0x00
	INC R28
	JMP ALARMA_HORAS_UNIDADES2
ALARMA_CERO6:
	CPI R28,0x00
	BREQ REINICIO
	LDI R27,0x09
	DEC R28
	JMP ALARMA_HORAS_DECENAS
ALARMA_CERO7:
	CPI R27,0x04
	BRNE MOSTRAR
	LDI R27,0x00
	LDI R28,0x00
	JMP MOSTRAR
REINICIO:
	LDI R27,0x03
	LDI R28,0x02
	JMP MOSTRAR

M_ALARMA:
	CBI PORTC, 4
	SBI PORTB,5
	CBI PORTB,4
	CPI R25,0x0A
	BREQ ALARMA_CERO1
ALARMA_MINS_UNIDADES2:
	CPI R25,0xFF
	BREQ ALARMA_CERO2
ALARMA_MINS_DECENAS:
	CPI R26,0x06
	BREQ ALARMA_CERO3
ALARMA_MINS_DECENAS2:
	CPI R26,0xFF
	BREQ ALARMA_CERO4
ALARMA_HORAS_UNIDADES:
	CPI R27,0x0A
	BREQ ALARMA_CERO5
ALARMA_HORAS_UNIDADES2:
	CPI R27,0xFF
	BREQ ALARMA_CERO6
ALARMA_HORAS_DECENAS:
	CPI R28,0x2
	BREQ ALARMA_CERO7
MOSTRAR:
	LDI ZH, HIGH(DIS << 1)
	LDI ZL, LOW(DIS << 1)
	ADD ZL,R25
	LPM R23, Z
	CBI PORTB, 0
	CBI PORTB, 1
	CBI PORTB, 2
	CBI PORTB, 3
	OUT PORTD, R23
	SBI PORTB, 0
	CALL DELAY
	CBI PORTB, 0
	LDI ZH, HIGH(DIS << 1)
	LDI ZL, LOW(DIS << 1)
	ADD ZL,R26
	LPM R23, Z
	OUT PORTD, R23
	SBI PORTB, 1
	CALL DELAY
	CBI PORTB, 1
	LDI ZH, HIGH(DIS << 1)
	LDI ZL, LOW(DIS << 1)
	ADD ZL,R27
	LPM R23, Z
	OUT PORTD, R23
	SBI PORTB, 2
	CALL DELAY
	CBI PORTB, 2
	LDI ZH, HIGH(DIS << 1)
	LDI ZL, LOW(DIS << 1)
	ADD ZL,R28
	LPM R23, Z
	OUT PORTD, R23
	SBI PORTB, 3
	CALL DELAY
	JMP MAIN_LOOP

FECHA_CERO1:
	LDI R25,0x00
	INC R26
	JMP FECHA_MINS_UNIDADES2
FECHA_CERO2:
	LDI R25,0x09
	DEC R26 
	JMP FECHA_MINS_DECENAS
FECHA_CERO3:
	LDI R26,0x00
	JMP FECHA_MINS_DECENAS2
FECHA_CERO4:
	LDI R26,0x5
	JMP FECHA_HORAS_UNIDADES
FECHA_CERO5:
	LDI R27,0x00
	INC R28
	JMP FECHA_HORAS_UNIDADES2
FECHA_CERO6:
	CPI R28,0x00
	BREQ REINICIO2
	LDI R27,0x09
	DEC R28
	JMP FECHA_HORAS_DECENAS
FECHA_CERO7:
	CPI R27,0x04
	BRNE MOSTRAR2
	LDI R27,0x00
	LDI R28,0x00
	JMP MOSTRAR2
REINICIO2:
	LDI R27,0x03
	LDI R28,0x02
	JMP MOSTRAR2

M_FECHA:
	SBI PORTB,4
	SBI PORTB,4
	CBI PORTC,4
	CPI R25,0x0A
	BREQ FECHA_CERO1
FECHA_MINS_UNIDADES2:
	CPI R25,0xFF
	BREQ FECHA_CERO2
FECHA_MINS_DECENAS:
	CPI R26,0x02
	BREQ FECHA_CERO3
FECHA_MINS_DECENAS2:
	CPI R26,0xFF
	BREQ FECHA_CERO4
FECHA_HORAS_UNIDADES:
	CPI R27,0x0A
	BREQ FECHA_CERO5
FECHA_HORAS_UNIDADES2:
	CPI R27,0xFF
	BREQ FECHA_CERO6
FECHA_HORAS_DECENAS:
	CPI R28,0x2
	BREQ FECHA_CERO7
MOSTRAR2:
	LDI ZH, HIGH(DIS << 1)
	LDI ZL, LOW(DIS << 1)
	ADD ZL,R25
	LPM R23, Z
	CBI PORTB, 0
	CBI PORTB, 1
	CBI PORTB, 2
	CBI PORTB, 3
	OUT PORTD, R23
	SBI PORTB, 0
	CALL DELAY
	CBI PORTB, 0
	LDI ZH, HIGH(DIS << 1)
	LDI ZL, LOW(DIS << 1)
	ADD ZL,R26
	LPM R23, Z
	OUT PORTD, R23
	SBI PORTB, 1
	CALL DELAY
	CBI PORTB, 1
	LDI ZH, HIGH(DIS << 1)
	LDI ZL, LOW(DIS << 1)
	ADD ZL,R27
	LPM R23, Z
	OUT PORTD, R23
	SBI PORTB, 2
	CALL DELAY
	CBI PORTB, 2
	LDI ZH, HIGH(DIS << 1)
	LDI ZL, LOW(DIS << 1)
	ADD ZL,R28
	LPM R23, Z
	OUT PORTD, R23
	SBI PORTB, 3
	CALL DELAY
JMP MAIN_LOOP


M_RELOJ_ALARMA:
	LDI ZH, 0x01
	LDI ZL, 0x00
	LD R25,Z
	LDI ZH, 0x01
	LDI ZL, 0x01
	LD R26,Z
	LDI ZH, 0x01
	LDI ZL, 0x02
	LD R27,Z
	LDI ZH, 0x01
	LDI ZL, 0x03
	LD R28,Z
	SBI PORTB,4
	CBI PORTB,5
	CPI R29, 50
	BRNE CONTAR
	CLR R29
	SBIS PINC,4
	JMP ENCENDER
	SBIC PINC,4
	JMP APAGAR

ENCENDER:
	SBI PORTC,4
	JMP CONTAR
APAGAR:
	CBI PORTC,4
	JMP CONTAR
CONTAR:
	CP R16, R25
	BREQ COMPARAR2
	CBI PORTC,5
	JMP RELOJ
COMPARAR2:
	CP R17, R26
	BREQ COMPARAR3
	CBI PORTC,5
	JMP RELOJ
COMPARAR3:
	CP R18, R27
	BREQ COMPARAR4
	CBI PORTC,5
	JMP RELOJ
COMPARAR4:
	CP R19, R28
	BREQ ACTIVAR_ALARMA
	CBI PORTB,7
	JMP RELOJ
ACTIVAR_ALARMA:
	SBI PORTC, 5
RELOJ:
	LDI ZH, HIGH(DIS << 1)
	LDI ZL, LOW(DIS << 1)
	ADD ZL,R16
	LPM R22, Z
	CBI PORTB, 0
	CBI PORTB, 1
	CBI PORTB, 2
	CBI PORTB, 3
	OUT PORTD, R22
	SBI PORTB, 0
	CALL DELAY
	CBI PORTB, 0
	LDI ZH, HIGH(DIS << 1)
	LDI ZL, LOW(DIS << 1)
	ADD ZL,R17
	LPM R22, Z
	OUT PORTD, R22
	SBI PORTB, 1
	CALL DELAY
	CBI PORTB, 1
	LDI ZH, HIGH(DIS << 1)
	LDI ZL, LOW(DIS << 1)
	ADD ZL,R18
	LPM R22, Z
	OUT PORTD, R22
	SBI PORTB, 2
	CALL DELAY
	CBI PORTB, 2
	LDI ZH, HIGH(DIS << 1)
	LDI ZL, LOW(DIS << 1)
	ADD ZL,R19
	LPM R22, Z
	OUT PORTD, R22
	SBI PORTB, 3
	CALL DELAY
	CBI PORTB, 3
	JMP MAIN_LOOP

DELAY:
LDI R31,0
subdelay1:
INC R31
CPI R31,0x00
BRNE subdelay1
RET

DELAY2:
LDI R31,0
subdelay1_2:
INC R31
CPI R31,0x00
BRNE subdelay1_2
LDI R31,0
subdelay2_2:
INC R31
CPI R31,0x00
BRNE subdelay2_2
LDI R31,0
subdelay3_2:
INC R31
CPI R31,0x00
BRNE subdelay3_2
LDI R31,0
subdelay4_2:
INC R31
CPI R31,0x00
BRNE subdelay4_2
LDI R31,0
subdelay5_2:
INC R31
CPI R31,0x00
BRNE subdelay5_2
RET

PINCHANGEC_ISR:
	IN R23, PINC
	CP R30,R23
	BREQ SALIR
	CALL DElAY2
	IN R23, PINC
	CP R30,R23
	BREQ SALIR
	CALL DElAY2
	IN R23, PINC
	CP R30,R23
	BREQ SALIR
	MOV R30,R23
	ANDI R24,0x03
	CPI R24,0x02
	BREQ CONF_ALARM
	CPI R24,0x00
	BREQ CONF_FECHA
	SBIS PINC,0
	INC R24
	ANDI R24,0x03
SALIR:
RETI

GUARDAR:
	CPI R24,0x02
	BREQ GUARDAR_ALARMA
	CPI R24,0x03
	BREQ GUARDAR_FECHA
RETI

CONF_ALARM:
	SBIS PINC,0
	JMP GUARDAR_ALARMA
	SBIS PINC,3
	RJMP MINUTOS
	RJMP HORAS
MINUTOS:
	SBIS PINC,1
	INC R25
	SBIS PINC,2
	DEC R25
RETI
HORAS:
	SBIS PINC,1
	INC R27
	SBIS PINC,2
	DEC R27
RETI

GUARDAR_FECHA:
	INC R24
	ANDI R24,0x03
	LDI ZH, 0x02
	LDI ZL, 0x00
	ST Z,R25
	LDI ZH, 0x02
	LDI ZL, 0x01
	ST Z,R26
	LDI ZH, 0x02
	LDI ZL, 0x02
	ST Z,R27
	LDI ZH, 0x02
	LDI ZL, 0x03
	ST Z,R28
RETI

GUARDAR_ALARMA:
	INC R24
	ANDI R24,0x03
	LDI ZH, 0x01
	LDI ZL, 0x00
	ST Z,R25
	LDI ZH, 0x01
	LDI ZL, 0x01
	ST Z,R26
	LDI ZH, 0x01
	LDI ZL, 0x02
	ST Z,R27
	LDI ZH, 0x01
	LDI ZL, 0x03
	ST Z,R28
	
RETI


CONF_FECHA:
	SBIS PINC,0
	JMP GUARDAR_FECHA
	SBIS PINC,3
	RJMP MES
	RJMP DIA
DIA:
	SBIS PINC,1
	INC R25
	SBIS PINC,2
	DEC R25
RETI
MES:
	SBIS PINC,1
	INC R27
	SBIS PINC,2
	DEC R27
RETI
RETI

TMR0_ISR:
	LDI R22, 100
	OUT TCNT0, R22
	INC R20
	INC R29
	CPI R20, 250
	BREQ REGISTRO2
RETI
	REGISTRO2:
	INC R21
RETI

