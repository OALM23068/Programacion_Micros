;
; prueba_1.asm
;
; Created: 2/26/2025 7:31:39 PM
; Author : oscar
;
.include "M328PDEF.inc"
.cseg
.org 0x0000
	JMP START
.org 0x0008
	JMP PINCHANGEC_ISR
.org 0x0020
	JMP TMR0_ISR

START:
// Configuraci n de la pila?
	LDI R16, LOW(RAMEND)
	OUT SPL, R16
	LDI R16, HIGH(RAMEND)
	OUT SPH, R16	

DIS: .DB 0x3F,0x05,0x5B,0x4F,0x65,0x6E,0x7E,0x07,0x7F,0x67,0x77,0x7F,0x3A,0x3F,0x7A,0x72
MESES: .DB 0x31,0x28,0x31,0x30,0x31,0x30,0x31,0x31,0x30,0x31,0x30,0x31

SETUP:
	CLI

	LDI R16, (1 << CLKPCE)
	STS CLKPR, R16
	LDI R16, 0b00000100
	STS CLKPR,R16

	LDI R16,(1 << CS01)|(1 << CS00)
	OUT TCCR0B, R16
	LDI R16,100
	OUT TCNT0, R16

	LDI R16, (1 << TOIE0)
	STS TIMSK0, R16

	LDI R16, (1 << PCIE1)
	STS PCICR, R16
	LDI R16,(1 << PCINT13)|(1 << PCINT11)|(1 << PCINT10)|(1 << PCINT9)|(1 << PCINT8)
	STS PCMSK1, R16

	
	LDI R16,0x00
	OUT PORTD, R16
	OUT PORTB, R16
	STS UCSR0B, R16
	LDI R16,0x10
	OUT DDRC,R16
	LDI R16,0xFF
	OUT PORTC, R16
	OUT DDRB,R16
	OUT DDRD, R16
	
	SEI

// Contador horas y mins
	LDI R16,0x00
	LDI R17,0x00
	LDI R18,0x00
	LDI R19,0x00
// Contadores para minutos
	LDI R20,0x00
	LDI R21,0x00
// Valor a mostrar en displays
	LDI R22,0x00
// Valores temporales
	LDI R23,0x00
// Modo del sistema
	LDI R24,0x02
// Registros Alarma y Fecha
	LDI R25,0x01
	LDI R26,0x00
	LDI R27,0x00
	LDI R28,0x00
// Registro para puntos cada 500ms
	LDI R29,0x00
//Seleccionar que incrementar
	LDI R30,0x01
// Registro para el delay de los displays
	LDI R31,0x00

	
	CBI PORTC,5
; Replace with your application code
MAIN_LOOP:
	CPI R24,0x00
	BREQ APAGADO
	CPI R24,0x02
	BREQ ALARMA
	CPI R24,0x03
	BREQ FECHA
	JMP MAIN_LOOP

RELOJ:
JMP M_RELOJ
APAGADO:
JMP M_APAGAR
FECHA:
JMP M_FECHA
ALARMA:
JMP M_ALARMA

M_APAGAR:
	CBI PORTC, 4
	CBI PORTB, 4
	CBI PORTB, 5
	LDI R25,0x00
	LDI R26,0x00
	LDI R27,0x00
	LDI R28,0x00
	JMP MAIN_LOOP

M_RELOJ:
JMP MAIN_LOOP
ALARMA_CERO1:
	LDI R25,0x00
	INC R26
	JMP ALARMA_MINS_UNIDADES2
ALARMA_CERO2:
	LDI R25,0x09
	DEC R26 
	JMP ALARMA_MINS_DECENAS
ALARMA_CERO3:
	LDI R26,0x00
	JMP ALARMA_MINS_DECENAS2
ALARMA_CERO4:
	LDI R26,0x5
	JMP ALARMA_HORAS_UNIDADES
ALARMA_CERO5:
	LDI R27,0x00
	INC R28
	JMP ALARMA_HORAS_UNIDADES2
ALARMA_CERO6:
	CPI R28,0x00
	BREQ REINICIO
	LDI R27,0x09
	DEC R28
	JMP ALARMA_HORAS_DECENAS
ALARMA_CERO7:
	CPI R27,0x04
	BRNE MOSTRAR
	LDI R27,0x00
	LDI R28,0x00
	JMP MOSTRAR
REINICIO:
	LDI R27,0x03
	LDI R28,0x02
	JMP MOSTRAR

M_ALARMA:
	CBI PORTC, 4
	SBI PORTB,5
	CBI PORTB,4
	CPI R25,0x0A
	BREQ ALARMA_CERO1
ALARMA_MINS_UNIDADES2:
	CPI R25,0xFF
	BREQ ALARMA_CERO2
ALARMA_MINS_DECENAS:
	CPI R26,0x06
	BREQ ALARMA_CERO3
ALARMA_MINS_DECENAS2:
	CPI R26,0xFF
	BREQ ALARMA_CERO4
ALARMA_HORAS_UNIDADES:
	CPI R27,0x0A
	BREQ ALARMA_CERO5
ALARMA_HORAS_UNIDADES2:
	CPI R27,0xFF
	BREQ ALARMA_CERO6
ALARMA_HORAS_DECENAS:
	CPI R28,0x2
	BREQ ALARMA_CERO7
MOSTRAR:
	LDI ZH, HIGH(DIS << 1)
	LDI ZL, LOW(DIS << 1)
	ADD ZL,R25
	LPM R22, Z
	CBI PORTB, 0
	CBI PORTB, 1
	CBI PORTB, 2
	CBI PORTB, 3
	OUT PORTD, R22
	SBI PORTB, 0
	CALL DELAY
	CBI PORTB, 0
	LDI ZH, HIGH(DIS << 1)
	LDI ZL, LOW(DIS << 1)
	ADD ZL,R26
	LPM R22, Z
	OUT PORTD, R22
	SBI PORTB, 1
	CALL DELAY
	CBI PORTB, 1
	LDI ZH, HIGH(DIS << 1)
	LDI ZL, LOW(DIS << 1)
	ADD ZL,R27
	LPM R22, Z
	OUT PORTD, R22
	SBI PORTB, 2
	CALL DELAY
	CBI PORTB, 2
	LDI ZH, HIGH(DIS << 1)
	LDI ZL, LOW(DIS << 1)
	ADD ZL,R28
	LPM R22, Z
	OUT PORTD, R22
	SBI PORTB, 3
	CALL DELAY
	JMP MAIN_LOOP

M_FECHA:
	CBI PORTC, 4
	SBI PORTB,5
	SBI PORTB,4
	OUT PORTD,R22
	JMP MAIN_LOOP


DELAY:
LDI R31, 100
subdelay1:
INC R31
CPI R31,0x00
BRNE subdelay1
RET

PINCHANGEC_ISR:
	SBIS PINC,0
	INC R24
	CPI R24,0x02
	BREQ CONF_ALARM
	CPI R24,0x03
	BREQ CONF_FECHA
	ANDI R24,0x03
RETI

CONF_ALARM:
	CPI R30,0x00
	BREQ HORAS
	CPI R30,0x01
	BREQ MINUTOS

MINUTOS:
	SBIS PINC,1
	INC R25
	SBIS PINC,2
	DEC R25
RETI
HORAS:
	SBIS PINC,1
	INC R27
	SBIS PINC,2
	DEC R27
RETI

CONF_FECHA:
	SBIS PINC,0
	INC R25
	SBIS PINC,1
	DEC R26
	SBIS PINC,2
	INC R27
	SBIS PINC,3
	DEC R28
RETI

GUARDAR_ALARMA:
	LDI ZH, 0x01
	LDI ZL, 0x00
	ST Z,R25
	LDI ZH, 0x01
	LDI ZL, 0x01
	ST Z,R26
	LDI ZH, 0x01
	LDI ZL, 0x02
	ST Z,R27
	LDI ZH, 0x01
	LDI ZL, 0x03
	ST Z,R28
RETI

TMR0_ISR:
	LDI R22, 100
	OUT TCNT0, R22
	INC R20
	INC R29
	CPI R20, 250
	BREQ REGISTRO2
RETI
	REGISTRO2:
	INC R21
RETI

