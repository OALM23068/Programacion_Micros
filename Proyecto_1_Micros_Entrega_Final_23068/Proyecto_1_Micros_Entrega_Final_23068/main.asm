;
; Proyecto_1_Micros_Entrega_Final_23068.asm
;
; Created: 3/6/2025 4:12:37 PM
; Author : oscar
;
.include "M328PDEF.inc"
.cseg
.org 0x0000
	JMP START
.org 0x0008
	JMP PINCHANGEC_ISR
.org 0x0020
	JMP TMR0_ISR


START:

// Configuraci n de la pila?
	LDI R16, LOW(RAMEND)
	OUT SPL, R16
	LDI R16, HIGH(RAMEND)
	OUT SPH, R16

DIS: .DB 0x3F,0x05,0x5B,0x4F,0x65,0x6E,0x7E,0x07,0x7F,0x67
MESES: .DB 0x1F,0x1C,0x1F,0x1E,0x1F,0x1E,0x1F,0x1F,0x1E,0x1F,0x1E,0x1F



SETUP:

	CLI

	LDI R16, (1 << CLKPCE)
	STS CLKPR, R16
	LDI R16, 0b00000100
	STS CLKPR,R16

	LDI R16,(1 << CS01)|(1 << CS00)
	OUT TCCR0B, R16
	LDI R16,100
	OUT TCNT0, R16

	LDI R16, (1 << TOIE0)
	STS TIMSK0, R16

	LDI R16, (1 << PCIE1)
	STS PCICR, R16
	LDI R16,(1 << PCINT13)|(1 << PCINT11)|(1 << PCINT10)|(1 << PCINT9)|(1 << PCINT8)
	STS PCMSK1, R16
	
	LDI R16,0x00
	OUT PORTD, R16
	OUT PORTB, R16
	STS UCSR0B, R16
	LDI R16,0x30
	OUT DDRC,R16
	LDI R16,0xFF
	OUT PORTC, R16
	OUT DDRB,R16
	OUT DDRD, R16


	
	SEI

	LDI R16,0x00
	MOV R0,R16
	LDI R16,0x00
	MOV R1,R16
	LDI R16,0x00
	MOV R2,R16
	LDI R16,0x00
	MOV R3,R16
	LDI R16,0x00
	MOV R4,R16
	MOV R5,R16
	MOV R6,R16
	MOV R7,R16
	MOV R8,R16 
	MOV R9,R16
	MOV R10,R16
	MOV R11,R16
	MOV R12,R16
	MOV R13,R16
	MOV R14,R16
	MOV R15,R16

	INC R4
	INC R6
// Registro mover informacion
	LDI R16,0x00
// Contadores para minutos
	LDI R17,0x00
	LDI R18,0x00
// Valores temporales
	LDI R20,0x00
// Modo del sistema
	LDI R21,0x01
//Alarma estado
	LDI R22,0x00
// Registro para puntos cada 500ms
	LDI R29,0x00
// Registro para el delay de los displays
	LDI R31,0x00

MAIN_LOOP:
	ANDI R21,0x07 
	CPI R21,0x00
	BREQ SALTO_APAGADO
	CPI R21,0x01
	BREQ SALTO_RELOJ
	CPI R21,0x02
	BREQ SALTO_FECHA
	CPI R21,0x03
	BREQ SALTO_CONFIG_HORA
	CPI R21,0x04
	BREQ SALTO_CONFIG_FECHA
	CPI R21,0x05
	BREQ SALTO_CONFIG_ALARMA
	CPI R21,0x06
	BREQ SALTO_APAGAR_ALARMA
	JMP MAIN_LOOP

SALTO_APAGADO:
	JMP APAGADO
SALTO_RELOJ:
	JMP RELOJ
SALTO_FECHA:
	JMP FECHA
SALTO_CONFIG_HORA:
	JMP CONFIG_HORA
SALTO_CONFIG_FECHA:
	JMP CONFIG_FECHA
SALTO_CONFIG_ALARMA:
	JMP CONFIG_ALARMA
SALTO_APAGAR_ALARMA:
	JMP APAGAR_ALARMA

RESTRICCIONES:
	CPI R18, 24
	BRNE FINAL
	CLR R17
	CLR R18
	INC R0
	LDI R16,0x0A
	CP R0,R16
	BREQ OVER_UNIDADES_SEGUNDOS
CASO2_RELOJ:
	LDI R16,0x06
	CP R1,R16
	BREQ OVER_DECENA_SEGUNDOS
CASO3_RELOJ:
	LDI R16,0x04
	CP R2,R16
	BREQ OVER_UNIDADES_HORA
CASO4_RELOJ:
	LDI R16,0x0A
	CP R2,R16
	BREQ OVER_DECENAS_HORA
CASO5_FECHA:
	LDI R16,0x0A
	CP R4,R16
	BREQ OVER_UNIDADES_DIA_FECHA
CASO6_FECHA:
	MOV R16,R13
	LDI ZH, HIGH(MESES << 1)
	LDI ZL, LOW(MESES << 1)
	ADD ZL,R16
	LPM R16, Z
	CP R12,R16
	BRGE OVER_DIAS_FECHA
CASO7_FECHA:
	LDI R16,0x0A
	CP R6,R16
	BREQ OVER_MES_UNIDADES_FECHA
CASO8_FECHA:
	LDI R16,0x0C
	CP R13,R16
	BREQ OVER_MES_FECHA
FINAL:
	RET

OVER_UNIDADES_SEGUNDOS:
	LDI R16, 0x00
	MOV R0,R16
	INC R1
	RJMP CASO2_RELOJ
OVER_DECENA_SEGUNDOS:
	LDI R16, 0x00
	MOV R1,R16
	INC R2
	RJMP CASO3_RELOJ
OVER_UNIDADES_HORA:
	LDI R16, 0x02
	CP R3,R16
	BRNE CASO4_RELOJ
	LDI R16,0x00
	MOV R2,R16
	MOV R3,R16
	INC R4
	INC R12
	RJMP CASO5_FECHA
OVER_DECENAS_HORA:
	LDI R16, 0x00
	MOV R2,R16
	INC R3
	RJMP CASO5_FECHA
OVER_UNIDADES_DIA_FECHA:
	LDI R16,0x00
	MOV R4,R16
	INC R5
	INC R12
	RJMP CASO6_FECHA
OVER_DIAS_FECHA:
	LDI R16,0x01
	MOV R4,R16
	LDI R16,0x00
	MOV R12,R16
	MOV R5,R16
	INC R6
	INC R13
	RJMP CASO7_FECHA
OVER_MES_UNIDADES_FECHA:
	LDI R16,0x00
	MOV R6,R16
	INC R7
	RJMP CASO8_FECHA
OVER_MES_FECHA:
	LDI R16,0x01
	MOV R4,R16
	MOV R6,R16
	LDI R16,0x00
	MOV R7,R16
	MOV R8,R16
	MOV R13,R16
	RJMP FINAL

MOSTRAR_DISPLAY:
	LDI ZH, HIGH(DIS << 1)
	LDI ZL, LOW(DIS << 1)
	ADD ZL,R16
	LPM R16, Z
	OUT PORTD, R16
	RET

MOSTRAR_DISPLAY_RELOJ_Y_CONFIG_RELOJ:
	MOV R16,R0
	CBI PORTB, 0
	CBI PORTB, 1
	CBI PORTB, 2
	CBI PORTB, 3
	CALL MOSTRAR_DISPLAY
	SBI PORTB, 0
	CALL DELAY
	CBI PORTB, 0
	MOV R16,R1
	CALL MOSTRAR_DISPLAY
	SBI PORTB, 1
	CALL DELAY
	CBI PORTB, 1
	MOV R16,R2
	CALL MOSTRAR_DISPLAY
	SBI PORTB, 2
	CALL DELAY
	CBI PORTB, 2
	MOV R16,R3
	CALL MOSTRAR_DISPLAY
	SBI PORTB, 3
	CALL DELAY
	CBI PORTB, 3
	RET

MOSTRAR_DISPLAY_FECHA_Y_CONFIG_FECHA:
	MOV R16,R6
	CBI PORTB, 0
	CBI PORTB, 1
	CBI PORTB, 2
	CBI PORTB, 3
	CALL MOSTRAR_DISPLAY
	SBI PORTB, 0
	CALL DELAY
	CBI PORTB, 0
	MOV R16,R7
	CALL MOSTRAR_DISPLAY
	SBI PORTB, 1
	CALL DELAY
	CBI PORTB, 1
	MOV R16,R4
	CALL MOSTRAR_DISPLAY
	SBI PORTB, 2
	CALL DELAY
	CBI PORTB, 2
	MOV R16,R5
	CALL MOSTRAR_DISPLAY
	SBI PORTB, 3
	CALL DELAY
	CBI PORTB, 3
	RET

APAGADO:
	CBI PORTB,0
	CBI PORTB,1
	CBI PORTB,2
	CBI PORTB,3
	CBI PORTB,4
	CBI PORTB,5
	CBI PORTC,4
	JMP MAIN_LOOP

RELOJ:
	CALL RESTRICCIONES
	SBI PORTB,4
	CPI R29, 50
	BRNE RELOJ_MOSTRAR
	CLR R29
	SBIS PINC,4
	JMP ENCENDER
	SBIC PINC,4
	RJMP APAGAR
ENCENDER:
	SBI PORTC,4
	RJMP COMPARAR_ALARMA
APAGAR:
	CBI PORTC,4
COMPARAR_ALARMA:
	CP R0, R8
	BREQ COMPARAR2
	CBI PORTC,5
	JMP RELOJ
COMPARAR2:
	CP R1, R9
	BREQ COMPARAR3
	CBI PORTC,5
	JMP RELOJ
COMPARAR3:
	CP R2, R10
	BREQ COMPARAR4
	CBI PORTC,5
	JMP RELOJ
COMPARAR4:
	CP R3, R11
	BREQ COMPARAR5
	CBI PORTC,5
	JMP RELOJ_MOSTRAR
COMPARAR5:
	LDI R16,0x01
	CP R22,R16
	BREQ ACTIVAR_ALARMA
	CBI PORTC,5
	JMP RELOJ_MOSTRAR
ACTIVAR_ALARMA:
	SBI PORTC, 5
RELOJ_MOSTRAR:
	CALL MOSTRAR_DISPLAY_RELOJ_Y_CONFIG_RELOJ
	JMP MAIN_LOOP

FECHA:
	CALL RESTRICCIONES
	CALL MOSTRAR_DISPLAY_FECHA_Y_CONFIG_FECHA
	JMP MAIN_LOOP

CONFIG_HORA_CASO1:
	LDI R16,0x00
	MOV R0,R16
	INC R1
	JMP CONFIG_HORA_MINS_UNIDADES2
CONFIG_HORA_CASO2:
	LDI R16,0x09
	MOV R0,R16
	DEC R1 
	JMP CONFIG_HORA_MINS_DECENAS
CONFIG_HORA_CASO3:
	LDI R16,0x00
	MOV R1,R16
	JMP CONFIG_HORA_MINS_DECENAS2
CONFIG_HORA_CASO4:
	LDI R16,0x05
	MOV R1,R16
	JMP CONFIG_HORA_HORAS_UNIDADES
CONFIG_HORA_CASO5:
	LDI R16,0x00
	MOV R2,R16
	INC R3
	JMP CONFIG_HORA_HORAS_UNIDADES2
CONFIG_HORA_CASO6:
	LDI R16,0x00
	CP R3,R16
	BREQ CONFIG_HORA_REINICIO
	LDI R16,0x09
	MOV R2,R16
	DEC R3
	JMP CONFIG_HORA_HORAS_DECENAS
CONFIG_HORA_CASO7:
	LDI R16,0x04
	CP R2,R16
	BRNE CONFIG_HORA_MOSTRAR
	LDI R16,0x00
	MOV R2,R16
	MOV R3,R16
	JMP CONFIG_HORA_MOSTRAR
CONFIG_HORA_REINICIO:
	LDI R16,0x03
	MOV R2,R16
	LDI R16,0x02
	MOV R3,R16
	JMP CONFIG_HORA_MOSTRAR

CONFIG_HORA:
	CBI PORTB,0
	CBI PORTB,1
	CBI PORTB,2
	CBI PORTB,3
	CBI PORTB,4
	CBI PORTB,5
	CBI PORTC,4
	LDI R16,0x0A
	CP R0,R16
	BREQ CONFIG_HORA_CASO1
CONFIG_HORA_MINS_UNIDADES2:
	LDI R16,0xFF
	CP R0,R16
	BREQ CONFIG_HORA_Caso2
CONFIG_HORA_MINS_DECENAS:
	LDI R16,0x06
	CP R1,R16
	BREQ CONFIG_HORA_CASO3
CONFIG_HORA_MINS_DECENAS2:
	LDI R16,0xFF
	CP R1,R16
	BREQ CONFIG_HORA_CASO4
CONFIG_HORA_HORAS_UNIDADES:
	LDI R16,0x0A
	CP R2,R16
	BREQ CONFIG_HORA_CASO5
CONFIG_HORA_HORAS_UNIDADES2:
	LDI R16,0xFF
	CP R2,R16
	BREQ CONFIG_HORA_CASO6
CONFIG_HORA_HORAS_DECENAS:
	LDI R16,0x02
	CP R3,R16
	BREQ CONFIG_HORA_CASO7
CONFIG_HORA_MOSTRAR:
	CALL MOSTRAR_DISPLAY_RELOJ_Y_CONFIG_RELOJ
	JMP MAIN_LOOP

CASO_31_DIAS:
	LDI R16,0x1E
	MOV R12,R16
	LDI R16,0x03
	MOV R5,R16
	LDI R16,0x01
	MOV R4,R16
	JMP CASO_CONFIG_FECHA3
CASO_30_DIAS:
	LDI R16,0x1D
	MOV R12,R16
	LDI R16,0x03
	MOV R5,R16
	LDI R16,0x00
	MOV R4,R16
	JMP CASO_CONFIG_FECHA3
CASO_28_DIAS:
	LDI R16,0x1B
	MOV R12,R16
	LDI R16,0x02
	MOV R5,R16
	LDI R16,0x08
	MOV R4,R16
	JMP CASO_CONFIG_FECHA3


OVER_FECHA_UNIDADES1:
	LDI R16,0x00
	MOV R4,R16
	INC R5
	RJMP CASO_CONFIG_FECHA2
UNDER_FECHA_UNIDADES2:
	MOV R16,R13
	LDI ZH, HIGH(MESES << 1)
	LDI ZL, LOW(MESES << 1)
	ADD ZL,R16
	LPM R16, Z	
	CPI R16,0x1F
	BREQ CASO_31_DIAS
	CPI R16,0x1E
	BREQ CASO_30_DIAS
	CPI R16,0x1C
	BREQ CASO_28_DIAS
	RJMP CASO_CONFIG_FECHA3
OVER_FECHA_UNIDADES2:
	LDI R16,0x01
	MOV R4,R16
	LDI R16,0x00
	MOV R12,R16
	MOV R5,R16
	RJMP CASO_CONFIG_FECHA4
UNDER_FECHA_UNIDADES3:
	LDI R16,0x09
	MOV R4,R16
	DEC R5
	RJMP CASO_CONFIG_FECHA5
OVER_FECHA_MES1:
	LDI R16,0x00
	MOV R13,R16
	MOV R7,R16
	LDI R16,0x01
	MOV R6,R16
	RJMP CASO_CONFIG_FECHA6
UNDER_FECHA_MES1:
	LDI R16,0x0B
	MOV R13,R16
	LDI R16,0x01
	MOV R7,R16
	LDI R16,0x02
	MOV R6,R16
	RJMP CASO_CONFIG_FECHA7
OVER_FECHA_MES2:
	LDI R16,0x00
	MOV R6,R16
	INC R7
	RJMP CASO_CONFIG_FECHA8
UNDER_FECHA_MES2:
	LDI R16,0x09
	MOV R6,R16
	DEC R7

CONFIG_FECHA:
	LDI R16,0x0A
	CP R4,R16
	BREQ OVER_FECHA_UNIDADES1
CASO_CONFIG_FECHA2:
	LDI R16,0xFF
	CP R12,R16
	BREQ UNDER_FECHA_UNIDADES2
CASO_CONFIG_FECHA3:
	MOV R16,R13
	LDI ZH, HIGH(MESES << 1)
	LDI ZL, LOW(MESES << 1)
	ADD ZL,R16
	LPM R16, Z
	CP R12,R16
	BRGE OVER_FECHA_UNIDADES2
CASO_CONFIG_FECHA4:
	LDI R16,0xFF
	CP R4,R16
	BREQ UNDER_FECHA_UNIDADES3
CASO_CONFIG_FECHA5:
	LDI R16,0x0C
	CP R13,R16
	BREQ OVER_FECHA_MES1
CASO_CONFIG_FECHA6:
	LDI R16,0xFF
	CP R13,R16
	BREQ UNDER_FECHA_MES1
CASO_CONFIG_FECHA7:
	LDI R16,0x0A
	CP R6,R16
	BREQ OVER_FECHA_MES2
CASO_CONFIG_FECHA8:
	lDI R16,0x0FF
	CP R6,R16
	BREQ UNDER_FECHA_MES2
MOSTRAR_CONFIG_FECHA:
	CALL MOSTRAR_DISPLAY_FECHA_Y_CONFIG_FECHA
	JMP MAIN_LOOP


CONFIG_ALARMA_CASO1:
	LDI R16,0x00
	MOV R8,R16
	INC R9
	JMP CONFIG_ALARMA_MINS_UNIDADES2
CONFIG_ALARMA_CASO2:
	LDI R16,0x09
	MOV R8,R16
	DEC R9 
	JMP CONFIG_ALARMA_MINS_DECENAS
CONFIG_ALARMA_CASO3:
	LDI R16,0x00
	MOV R9,R16
	JMP CONFIG_ALARMA_MINS_DECENAS2
CONFIG_ALARMA_CASO4:
	LDI R16,0x05
	MOV R9,R16
	JMP CONFIG_ALARMA_HORAS_UNIDADES
CONFIG_ALARMA_CASO5:
	LDI R16,0x00
	MOV R10,R16
	INC R11
	JMP CONFIG_ALARMA_HORAS_UNIDADES2
CONFIG_ALARMA_CASO6:
	LDI R16,0x00
	CP R11,R16
	BREQ REINICIO_CONFIG_ALARMA
	LDI R16,0x09
	MOV R10,R16
	DEC R11
	JMP CONFIG_ALARMA_HORAS_DECENAS
CONFIG_ALARMA_CASO7:
	LDI R16,0x04
	CP R10,R16
	BRNE MOSTRAR_CONFIG_ALARMA
	LDI R16,0x00
	MOV R10,R16
	MOV R11,R16
	JMP MOSTRAR_CONFIG_ALARMA
REINICIO_CONFIG_ALARMA:
	LDI R16,0x03
	MOV R10,R16
	LDI R16,0x02
	MOV R11,R16
	JMP MOSTRAR_CONFIG_ALARMA

CONFIG_ALARMA:
	LDI R16,0x0A
	CP R8,R16
	BREQ CONFIG_ALARMA_CASO1
CONFIG_ALARMA_MINS_UNIDADES2:
	LDI R16,0xFF
	CP R8,R16
	BREQ CONFIG_ALARMA_CASO2
CONFIG_ALARMA_MINS_DECENAS:
	LDI R16,0x06
	CP R9,R16
	BREQ CONFIG_ALARMA_CASO3
CONFIG_ALARMA_MINS_DECENAS2:
	LDI R16,0xFF
	CP R9,R16
	BREQ CONFIG_ALARMA_CASO4
CONFIG_ALARMA_HORAS_UNIDADES:
	LDI R16,0x0A
	CP R10,R16
	BREQ CONFIG_ALARMA_CASO5
CONFIG_ALARMA_HORAS_UNIDADES2:
	LDI R16,0xFF
	CP R10,R16
	BREQ CONFIG_ALARMA_CASO6
CONFIG_ALARMA_HORAS_DECENAS:
	LDI R16,0x02
	CP R11,R16
	BREQ CONFIG_ALARMA_CASO7
MOSTRAR_CONFIG_ALARMA:
	MOV R16,R8
	CBI PORTB, 0
	CBI PORTB, 1
	CBI PORTB, 2
	CBI PORTB, 3
	CALL MOSTRAR_DISPLAY
	SBI PORTB, 0
	CALL DELAY
	CBI PORTB, 0
	MOV R16,R9
	CALL MOSTRAR_DISPLAY
	SBI PORTB, 1
	CALL DELAY
	CBI PORTB, 1
	MOV R16,R10
	CALL MOSTRAR_DISPLAY
	SBI PORTB, 2
	CALL DELAY
	CBI PORTB, 2
	MOV R16,R11
	CALL MOSTRAR_DISPLAY
	SBI PORTB, 3
	CALL DELAY
	CBI PORTB, 3
	JMP MAIN_LOOP

APAGAR_ALARMA:
	CPI R22,0x01
	BREQ ALARMA_ENCENDIDA_LEDS
	CBI PORTC,4
	JMP MAIN_LOOP
ALARMA_ENCENDIDA_LEDS:
	SBI PORTC,4
	JMP MAIN_LOOP

DELAY:
	LDI R31,0
	subdelay1:
	INC R31
	CPI R31,0x00
	BRNE subdelay1
RET

PINCHANGEC_ISR:
	CPI R23, 50
	BRNE SALIR
	CPI R21,0x00
	BREQ BOTONES_APAGADO
	SBIS PINC,0
	INC R21
	CPI R21,0x01
	BREQ BOTONES_RELOJ
	CPI R21,0x02
	BREQ BOTONES_FECHA
	CPI R21,0x03
	BREQ BOTONES_CONFIG_HORA
	CPI R21,0x04
	BREQ SALTO_BOTONES_CONFIG_FECHA
	CPI R21,0x05
	BREQ SALTO_BOTONES_CONFIG_ALARMA
	LDI R16,0x06
	CPSE R21,R16
	JMP SALIR
	JMP BOTONES_APAGAR_ALARMA
	SALIR:
RETI

SALTO_BOTONES_CONFIG_FECHA:
	JMP BOTONES_CONFIG_FECHA
SALTO_BOTONES_CONFIG_ALARMA:
	JMP BOTONES_CONFIG_ALARMA

BOTONES_APAGADO:
	CLR R23
	SBIS PINC,0
	RJMP CAMBIO_DE_MODO
RETI
CAMBIO_DE_MODO:
	INC R21
	LDI R20, 100
	OUT TCNT0, R20
	CLR R17
	CLR R18
	CLR R29
RETI

BOTONES_RELOJ:
	CLR R23
RETI

BOTONES_FECHA:
	CLR R23
RETI
BOTONES_CONFIG_HORA:
	CLR R23
	SBIS PINC,3
	RJMP HORAS_CONFIG_RELOJ 
MINUTOS_CONFIG_RELOJ:
	SBIS PINC,1
	INC R0
	SBIS PINC,2
	DEC R0
RETI
HORAS_CONFIG_RELOJ:
	SBIS PINC,1
	INC R2
	SBIS PINC,2
	DEC R2
RETI
BOTONES_CONFIG_FECHA:
	CLR R23
	SBIS PINC,3
	RJMP MES_FECHA
	RJMP DIA_FECHA 
DIA_FECHA:
	SBIS PINC,1
	RJMP SUMAR_D
	SBIS PINC,2
	RJMP RESTAR_D
RETI
SUMAR_D:
	INC R4
	INC R12
RETI
RESTAR_D:
	DEC R4
	DEC R12
RETI
MES_FECHA:
	SBIS PINC,1
	RJMP SUMAR_M
	SBIS PINC,2
	RJMP RESTAR_M
RETI
SUMAR_M:	
	INC R6
	INC R13
	LDI R16,0x00
	MOV R5,R16
	LDI R16,0x01
	MOV R4,R16
	LDI R16,0x00
	MOV R12,R16
RETI
RESTAR_M:
	DEC R6
	DEC R13
	LDI R16,0x00
	MOV R5,R16
	LDI R16,0x01
	MOV R4,R16
	LDI R16,0x00
	MOV R12,R16
RETI

BOTONES_CONFIG_ALARMA:
	CLR R23
	SBIS PINC,3
	RJMP HORAS_CONFIG_ALARMA
	RJMP MINUTOS_CONFIG_ALARMA
MINUTOS_CONFIG_ALARMA:
	SBIS PINC,1
	INC R8
	SBIS PINC,2
	DEC R8
RETI
HORAS_CONFIG_ALARMA:
	SBIS PINC,1
	INC R10
	SBIS PINC,2
	DEC R10
RETI

BOTONES_APAGAR_ALARMA:
	CLR R23
	SBIS PINC,1
	RJMP ALARMA_APAGADA
	SBIS PINC,2
	RJMP ALARMA_ENCENDIDA
RETI
ALARMA_ENCENDIDA:
	SBI PORTC,4
	LDI R22,0x01
RETI
ALARMA_APAGADA:
	CBI PORTC,4
	LDI R22,0x00
RETI

TMR0_ISR:
	LDI R20, 100
	OUT TCNT0, R20
	CPI R23, 50
	BREQ CASO_1_CONTAR
	INC R23
CASO_1_CONTAR:
	CPI R21,0x01
	BRNE CASO_2_CONTAR
	INC R17
	INC R29
CASO_2_CONTAR:
	CPI R21,0x02
	BRNE ENCENDER_PUNTOS
	INC R17
	INC R29
ENCENDER_PUNTOS:
	CPI R17, 250
	BREQ REGISTRO2
RETI
	REGISTRO2:
	INC R18
RETI