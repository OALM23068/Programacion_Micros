;
; LAB_Y_POSLAB_3.asm
;
; Created: 2/18/2025 10:44:21 PM
; Author : oscar
;
.include "M328PDEF.inc"
.cseg
.org 0x0000
	JMP START
.org 0x0008
	JMP PINCHANGEC_ISR
.org 0x0020
	JMP TMR0_ISR


DIS: .DB 0x3F,0x05,0x5B,0x4F,0x65,0x6E,0x7E,0x07,0x7F,0x67,0x77,0x7F,0x3A,0x3F,0x7A,0x72

START:
// Configuraci n de la pila?
	LDI R16, LOW(RAMEND)
	OUT SPL, R16
	LDI R16, HIGH(RAMEND)
	OUT SPH, R16	

SETUP:
	CLI

	LDI R16, (1 << CLKPCE)
	STS CLKPR, R16
	LDI R16, 0b00000100
	STS CLKPR,R16

	LDI R16,(1 << CS01)|(1 << CS00)
	OUT TCCR0B, R16
	LDI R16,100
	OUT TCNT0, R16

	LDI R16, (1 << TOIE0)
	STS TIMSK0, R16

	LDI R16, (1 << PCIE1)
	STS PCICR, R16
	LDI R16, (1 << PCINT9)|(1 << PCINT8)
	STS PCMSK1, R16

	
	LDI R16,0x00
	OUT PORTD, R16
	OUT PORTB, R16
	STS UCSR0B, R16
	LDI R16,0x3C
	OUT DDRC,R16
	LDI R16,0xFF
	OUT PORTC, R16
	OUT DDRB,R16
	OUT DDRD, R16
	
	SEI

//Contador
	LDI R16,0x00
	LDI R17,0x00
	LDI R19,0x00
	LDI R21,0x00
	LDI R26,0x00
// Valor display
	LDI R18,0x00

// Valor contador interrupciones
	LDI R22, 0x00


// Iniciamos solo un display

	

; Replace with your application code
MAIN_LOOP:
	LDI ZH, HIGH(DIS << 1)
	LDI ZL, LOW(DIS << 1)
	ADD ZL,R17
	LPM R18, Z
	CBI PORTC, 2
	CBI PORTC, 3
	CBI PORTC, 4
	CBI PORTC, 5
	OUT PORTD, R18
	SBI PORTC, 2
	CALL DELAY
	CBI PORTC,2
	LDI ZH, HIGH(DIS << 1)
	LDI ZL, LOW(DIS << 1)
	ADD ZL,R19
	LPM R18, Z
	OUT PORTD, R18
	SBI PORTC, 3
	CALL DELAY
	CBI PORTC, 3
	LDI ZH, HIGH(DIS << 1)
	LDI ZL, LOW(DIS << 1)
	ADD ZL,R21
	LPM R18, Z
	OUT PORTD, R18
	SBI PORTC, 4
	CALL DELAY
	CBI PORTC, 4
	LDI ZH, HIGH(DIS << 1)
	LDI ZL, LOW(DIS << 1)
	ADD ZL,R26
	LPM R18, Z
	OUT PORTD, R18
	SBI PORTC, 5
	CALL DELAY
	CPI R20, 100
	BRNE CONTADOR
	CLR R20
	INC R17
	CPI R17,0x0A
	BRBS 1, CERO
DECENAS:
	CPI R19,0x06
	BRBS 1, CERO2
CENTENAS:
	CPI R21,0x0A
	BRBS 1, CERO3
MILLARES:
	CPI R26,0x06
	BRBS 1, CERO4
CONTADOR:
	IN R23,PINB
	ANDI R23,0xF0
	ADD R23, R16
	OUT PORTB, R23
DISPLAY:
	RJMP MAIN_LOOP


CERO:
	LDI R17, 0x00
	INC R19
	RJMP DECENAS

CERO2:
	LDI R19, 0x00
	INC R21
	RJMP CENTENAS
CERO3:
	LDI R21,0x00
	INC R26
	RJMP MILLARES
CERO4:
	LDI R26,0x00
	RJMP DISPLAY

DELAY:
LDI R31,0x00
subdelay1:
INC R31
CPI R31,0x00
BRNE subdelay1
RET

PINCHANGEC_ISR:
	IN R24, PINC
	ANDI R24,0b00000011
	CP R24,R25
	BRBS 1, REBOTE
	SBIS PINC,0
	INC R16
	SBIS PINC,1
	DEC R16
	ANDI R16,0x0F
	MOV R25,R24
	
REBOTE:
RETI

TMR0_ISR:
	LDI R22, 100
	OUT TCNT0, R22
	INC R20
RETI
